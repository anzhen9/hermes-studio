## packages/esp-sparkbot/v2/main/Kconfig.projbuild
```kconfig
menu "Hermes SparkBot"

config HERMES_WAKE_WORD_DISPLAY
    string "Wake word shown to users"
    default "嘿，小方"

config HERMES_WAKE_WORD_COMMAND
    string "ESP-SR custom command for the wake word model"
    default "hei xiao fang"
    help
        This value must be present in the MultiNet command model packed with the
        firmware. Changing only the displayed text does not retrain a model.

config HERMES_WAKE_WORD_THRESHOLD
    int "Wake word recognition threshold (percent)"
    range 1 100
    default 75

endmenu
```

## packages/esp32-sparkbot/v2/sdkconfig.defaults
```kconfig
CONFIG_IDF_TARGET="esp32s3"
CONFIG_ESPTOOLPY_FLASHSIZE_16MB=y
CONFIG_ESPTOOLPY_FLASHMODE_QIO=y
CONFIG_ESPTOOLPY_FLASHFREQ_80M=y
CONFIG_ESPTOOLPY_MONITOR_BAUD=115200
CONFIG_FREERTOS_HZ=1000
CONFIG_ESP_MAIN_TASK_STACK_SIZE=8192
CONFIG_PARTITION_TABLE_CUSTOM=y
CONFIG_PARTITION_TABLE_CUSTOM_FILENAME="partitions.csv"
CONFIG_ESP32S3_SPIRAM_SUPPORT=y
CONFIG_SPIRAM_MODE_OCT=y
CONFIG_SPIRAM_SPEED_80M=y
CONFIG_SPIRAM_USE_MALLOC=y
CONFIG_ESP_SYSTEM_MEMPROT_FEATURE=n
CONFIG_ESP_WIFI_SOFTAP_SUPPORT=y
CONFIG_LWIP_MAX_SOCKETS=16
CONFIG_MBEDTLS_CERTIFICATE_BUNDLE=y
CONFIG_MBEDTLS_PSK_MODES=y
CONFIG_ESP_TLS_USING_MBEDTLS=y
CONFIG_MODEL_IN_FLASH=y
CONFIG_SR_MN_CN_MULTINET5_RECOGNITION_QUANT8=y
CONFIG_HERMES_WAKE_WORD_DISPLAY="嘿，小方"
CONFIG_HERMES_WAKE_WORD_COMMAND="hei xiao fang"
CONFIG_HERMES_WAKE_WORD_THRESHOLD=45
```
